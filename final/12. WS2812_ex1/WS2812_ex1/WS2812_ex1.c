/*
 * WS2812.c
 *
 * Created: 2025-11-24 오후 12:49:44
 * Author : jbhma
 */ 
#include <avr/io.h>
#define F_CPU 16000000L
#include <util/delay.h>
#define WC0 PORTC=0
#define WC1 PORTC=1

unsigned char c8x8[192]; // 8x8 픽셀 * 3색상(GRB) = 192 바이트
unsigned char ascii8x8[128][8] = {
   {0x00, 0x00, 0x00, 0x00, 0x00, 0x00, 0x00, 0x00},
   {0x00, 0x00, 0x00, 0x00, 0x00, 0x00, 0x00, 0x00},
   {0x00, 0x00, 0x00, 0x00, 0x00, 0x00, 0x00, 0x00},
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   {0x00, 0x00, 0x00, 0x00, 0x00, 0x00, 0x00, 0x00}   // 0x7F
};

void ascii2c(unsigned char iascii)
{
   unsigned char *pa, *pc;
   unsigned char i, r, g, b;
   pa = ascii8x8[iascii];
   pc = c8x8;
   r = 0x0f; g = 0x0f; b = 0x0f; // 밝기 조정 (너무 밝지 않게 설정)

   for(i=0; i<8; i++)
   {
      // 각 비트를 검사하여 색상 데이터(GRB) 채우기
      if(*pa & 0x01) {*pc++ = g; *pc++ = r; *pc++ = b;} else {*pc++ = 0; *pc++ = 0; *pc++ = 0;}
      if(*pa & 0x02) {*pc++ = g; *pc++ = r; *pc++ = b;} else {*pc++ = 0; *pc++ = 0; *pc++ = 0;}
      if(*pa & 0x04) {*pc++ = g; *pc++ = r; *pc++ = b;} else {*pc++ = 0; *pc++ = 0; *pc++ = 0;}
      if(*pa & 0x08) {*pc++ = g; *pc++ = r; *pc++ = b;} else {*pc++ = 0; *pc++ = 0; *pc++ = 0;}
      if(*pa & 0x10) {*pc++ = g; *pc++ = r; *pc++ = b;} else {*pc++ = 0; *pc++ = 0; *pc++ = 0;}
      if(*pa & 0x20) {*pc++ = g; *pc++ = r; *pc++ = b;} else {*pc++ = 0; *pc++ = 0; *pc++ = 0;}
      if(*pa & 0x40) {*pc++ = g; *pc++ = r; *pc++ = b;} else {*pc++ = 0; *pc++ = 0; *pc++ = 0;}
      if(*pa++ & 0x80) {*pc++ = g; *pc++ = r; *pc++ = b;} else {*pc++ = 0; *pc++ = 0; *pc++ = 0;}
   }
}
void T1(void) // H:0.85us L:0.45us 1.25us+_600ns 20+_9 instructions
{
   WC1;
   _delay_us(0.8); // 0.85
   WC0;
   _delay_us(0.3); // 0.4
}

void T0(void) // H0.4us L:0.85us
{
   WC1;
   _delay_us(0.3);
   WC0;
   _delay_us(0.8);
}

void TL(void) // Transmit Latch command L:50us
{
   WC0;
   _delay_us(60);
}

void TByte(unsigned char b) // MSB -> LSB
{
   if(b & 0x80) T1(); else T0();
   if(b & 0x40) T1(); else T0();
   if(b & 0x20) T1(); else T0();
   if(b & 0x10) T1(); else T0();
   if(b & 0x08) T1(); else T0();
   if(b & 0x04) T1(); else T0();
   if(b & 0x02) T1(); else T0();
   if(b & 0x01) T1(); else T0();
}
void disp_c(void)
{
   unsigned char i, *p;
   p = c8x8;
   for(i=0; i<192; i++)
   {
      TByte(*p++); // TByte 함수는 이전 단계에서 정의됨
   }
}

void test_dispc(void)
{
   unsigned char i;
   for(i=0x21; i<128; i++) // ASCII 문자 순회
   {
      TL(); // Reset 신호
      ascii2c(i); // 폰트 데이터를 LED 데이터로 변환
      disp_c();   // LED로 데이터 전송
      _delay_ms(1000);
   }
}

int main(void)
{
   DDRC = 0xff; // 포트 C 출력 설정
   while(1)
   {
      test_dispc();
   }
}

